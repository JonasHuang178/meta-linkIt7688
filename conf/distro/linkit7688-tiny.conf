## conf/distro/linkit7688-tiny.conf
```bitbake
require conf/distro/poky-tiny.conf

TCLIBC = "musl"
GCCVERSION ?= "7.%"
GDBVERSION ?= "7.%"
PREFERRED_PROVIDER_virtual/kernel = "linux-linkit7688"
PREFERRED_VERSION_linux-linkit7688 = "3.18%"
```

## conf/layer.conf
```bitbake
# We have a conf and classes directory, add to BBPATH
BBPATH .= ":${LAYERDIR}"

# We have recipes-* directories, add to BBFILES
BBFILES += "${LAYERDIR}/recipes-*/*/*.bb \
            ${LAYERDIR}/recipes-*/*/*.bbappend"

BBFILE_COLLECTIONS += "meta-linkit7688"
BBFILE_PATTERN_meta-linkit7688 = "^${LAYERDIR}/"
BBFILE_PRIORITY_meta-linkit7688 = "4"

LAYERDEPENDS_meta-linkit7688 = "core"
LAYERSERIES_COMPAT_meta-linkit7688 = "thud"
```

## conf/machine/linkit7688.conf
```bitbake
#@TYPE: Machine
#@NAME: linkit7688

#@DESCRIPTION: Machine configuration for linkit7688 system
require conf/machine/include/mips/tune-mips-24k.inc
DEFAULTTUNE = "mips32r2-24kec"

MACHINE_FEATURES = "usbhost serial wifi"

KERNEL_IMAGETYPE = "vmlinux"
KERNEL_ALT_IMAGETYPE = "vmlinux.bin"
KERNEL_IMAGE_STRIP_EXTRA_SECTIONS  = ".comment"

SERIAL_CONSOLE = "57600 ttyS2"
USE_VT ?= "0"

DISTRO_FEATURES_append += "sysvinit wifi ipv4"

# Little Endian
TUNE_FEATURES_tune-mips-nf = "o32"

TARGET_CFLAGS += " -pipe -mno-branch-likely -fno-caller-saves -minterlink-mips16 -fno-stack-protector "
TARGET_CXXFLAGS += " -pipe -mno-branch-likely -fno-caller-saves -minterlink-mips16 -fno-stack-protector "
```

## recipes-bsp/conf/machine/linkit7688.conf
```bitbake
#@TYPE: Machine
#@NAME: linkit7688

#@DESCRIPTION: Machine configuration for linkit7688 systems
require conf/machine/include/mips/tune-mips-24k.inc
DEFAULTTUNE = "mips32r2-24kec"

TCLIBC = "musl"
GCCVERSION ?= "7.%"
GDBVERSION ?= "7.%"

MACHINE_FEATURES = "usbhost serial wifi"

KERNEL_IMAGETYPE = "vmlinux"
KERNEL_ALT_IMAGETYPE = "vmlinux.bin"
KERNEL_IMAGE_STRIP_EXTRA_SECTIONS  = ".comment"

PREFERRED_PROVIDER_virtual/kernel="linux-yocto-linkit7688"
PREFERRED_VERSION_linux-yocto-linkit7688 ?= "3.18%"

SERIAL_CONSOLE = "57600 ttyS2"
USE_VT ?= "0"

DISTRO_FEATURES_append += "sysvinit wifi ipv4"

# Little Endian
TUNE_FEATURES_tune-mips-nf = "o32"

TARGET_CFLAGS += " -pipe -mno-branch-likely -fno-caller-saves -minterlink-mips16 -fno-stack-protector "
TARGET_CXXFLAGS += " -pipe -mno-branch-likely -fno-caller-saves -minterlink-mips16 -fno-stack-protector "
```
